// SPDX-License-Identifier: GPL-2.0
// Captured Pocket layout only. Keep vendor bconsole/ftrace/pmsg tail reserved.
/dts-v1/;
/plugin/;
/ {
    fragment@0 {
        target-path = "/reserved-memory";
        __overlay__ {
            #address-cells = <2>;
            #size-cells = <2>;
            mblock-10-pstore {
                compatible = "ramoops";
                reg = <0 0x54410000 0 0x8f000>;
                record-size = <0x1000>;
                console-size = <0x40000>;
                ftrace-size = <0>;
                pmsg-size = <0>;
                ecc-size = <0>;
                mem-type = <0>;
            };
            pstore-vendor-tail@5449f000 {
                reg = <0 0x5449f000 0 0x51000>;
                no-map;
            };
        };
    };
};
