// SPDX-License-Identifier: GPL-2.0
// Derived from the captured Pocket register-bank ordering, not another SoC.
/dts-v1/;
/plugin/;
/ {
	fragment@0 {
		target-path = "/1000b000.pinctrl";
		#address-cells = <2>;
		#size-cells = <2>;
		__overlay__ {
			reg = <0x0 0x10005000 0x0 0x1000>,
				<0x0 0x11f20000 0x0 0x1000>,
				<0x0 0x11e80000 0x0 0x1000>,
				<0x0 0x11e70000 0x0 0x1000>,
				<0x0 0x11e90000 0x0 0x1000>,
				<0x0 0x11d30000 0x0 0x1000>,
				<0x0 0x11d20000 0x0 0x1000>,
				<0x0 0x11c50000 0x0 0x1000>,
				<0x0 0x11f30000 0x0 0x1000>,
				<0x0 0x1000b000 0x0 0x1000>;
			reg-names = "gpio", "iocfg0", "iocfg1", "iocfg2", "iocfg3", "iocfg4", "iocfg5", "iocfg6", "iocfg7", "eint";
		};
	};
};
